## meta-openpower/conf/distro/openbmc-openpower.conf
```bitbake
require conf/distro/include/phosphor-base.inc
require conf/distro/include/openpower-distrovars.inc
require conf/distro/include/phosphor-isolation.inc
# TODO ANDREWG - hard coded in this openpower-ubi.inc
require conf/distro/include/openpower-ubi.inc
```
